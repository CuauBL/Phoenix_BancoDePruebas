#include <DHT.h>
#include <DHT_U.h>
#include <Adafruit_SSD1306.h>
#include <Adafruit_GFX.h>
#include <splash.h>
#include <SPI.h>
#include <Wire.h>

#define SCREEN_WIDTH 128
#define SCREEN_HEIGHT 64

//variante SPI
#define OLED_MOSI 9//D1
#define OLED_CLK  10//D0
#define OLED_DC   11
#define OLED_CS   12
#define OLED_RESET 13
#define ARRIBA 4
#define ABAJO 5
#define SELEC 6
#define BACK 7
Adafruit_SSD1306 display(SCREEN_WIDTH, SCREEN_HEIGHT,
  OLED_MOSI, OLED_CLK, OLED_DC, OLED_RESET, OLED_CS);
int arr;
int aba;
int selec;
int back;
int color = 3;
int i=0;
int sensor =2;
DHT dht(sensor,DHT11);
// 'Phoenix', 128x64px
const unsigned char Logo [] PROGMEM = {
  0xff, 0xff, 0xff, 0xff, 0xff, 0xff, 0xff, 0xff, 0xff, 0xff, 0xff, 0xff, 0xff, 0xff, 0xff, 0xff, 
  0xff, 0xff, 0xff, 0xff, 0xff, 0xff, 0xff, 0xff, 0xff, 0xff, 0xff, 0xc1, 0xff, 0xff, 0xff, 0xff, 
  0xff, 0xff, 0xff, 0xff, 0xff, 0xff, 0xff, 0xff, 0xff, 0xff, 0xf0, 0x01, 0xff, 0xff, 0xff, 0xff, 
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  0xff, 0xff, 0xff, 0xff, 0x01, 0xff, 0xff, 0xff, 0xff, 0xff, 0xff, 0xff, 0xff, 0xff, 0xff, 0xff
};
int temperatura;
int humedad;

void setup() {
 Serial.begin(9600);
 dht.begin();
 display.begin(SSD1306_SWITCHCAPVCC);
 pinMode(ARRIBA, INPUT);
 pinMode(ABAJO, INPUT);
 pinMode(SELEC, INPUT);
 pinMode(BACK, INPUT);
 display.clearDisplay();
 display.drawBitmap(0,0,Logo,128,64,1);
 display.display();
 delay(3000);
  }
  

void loop() {
  arr = digitalRead(ARRIBA);
  aba = digitalRead(ABAJO);
  selec=digitalRead(SELEC);
  back=digitalRead(BACK);
 if(arr == HIGH){
  Serial.println(color);
  color++;
  Serial.println(color);
  delay(250);
 }
 if(aba == HIGH){
  Serial.println(color);
  color--;
  Serial.println(color);
  delay(250);
 }
 if(back == HIGH){
  Serial.println("activo");
 }

if (color == 3){
  display.clearDisplay();
  display.setTextSize(2);
  display.setTextColor(SSD1306_BLACK, SSD1306_WHITE);
  display.setCursor(0,0);
  display.println("Opcion A");
  display.setTextColor(SSD1306_WHITE);
  display.println("Opcion B");
  display.setTextColor(SSD1306_WHITE);
  display.println("Opcion C");
  display.display();

selec=digitalRead(SELEC);
if(selec==HIGH){
   i=1;
   display.clearDisplay();
}
  while(i == 1){
  
  display.setTextSize(1);
  display.setTextColor(SSD1306_WHITE);
  display.setCursor(0,0);
  display.println("¡Seleccionaste A!");
  display.setTextColor(SSD1306_WHITE);
  display.setCursor(0,40);
  display.println("Presiona BACK para regresar");
  display.display();
  display.clearDisplay();

  back=digitalRead(BACK);
  if(back==HIGH){i=0;}}
  
 
  }



if (color == 2){
  display.clearDisplay();
  display.setTextSize(2);
  display.setTextColor(SSD1306_WHITE);
  display.setCursor(0,0);
  display.println("Opcion A");
  display.setTextColor(SSD1306_BLACK, SSD1306_WHITE);
  display.println("Opcion B");
  display.setTextColor(SSD1306_WHITE);
  display.println("Opcion C");
  display.display();

  selec=digitalRead(SELEC);
if(selec==HIGH){
   i=1;
   display.clearDisplay();
}
  while(i == 1){
    display.clearDisplay();// se necesita para refrescar el buffer
    display.setTextSize(1);
    display.setTextColor(SSD1306_WHITE);
    temperatura= dht.readTemperature();
    humedad = dht.readHumidity();
    display.setTextColor(WHITE); //Establece el color 
  
    display.setCursor(5,5); //Establecer las coordenadas para mostrar la posición del texto
    display.print("Temperatura: ");
    display.print(temperatura);
    display.println(" 'C");

    display.setCursor(20,20); 
    display.print(" Humedad: ");
    display.print(humedad);
    display.println("%");
    display.display();
    delay(100);

    back=digitalRead(BACK);
    if(back==HIGH){i=0;}}
  
 
  }


if (color == 1){
  display.clearDisplay();
  display.setTextSize(2);
  display.setTextColor(SSD1306_WHITE);
  display.setCursor(0,0);
  display.println("Opcion A");
  display.setTextColor(SSD1306_WHITE);
  display.println("Opcion B");
  display.setTextColor(SSD1306_BLACK, SSD1306_WHITE);
  display.println("Opcion C");
  display.display();
}
if (color < 1){
  color= 3;
}
if(color > 3){
  color = 1;
}
 
 }
