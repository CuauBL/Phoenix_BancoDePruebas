#include <Adafruit_SH1106.h>
#include <DHT.h>
#include <DHT_U.h>
#include <Adafruit_GFX.h>
#include <splash.h>
#include <SPI.h>
#include <Wire.h>

#define OLED_RESET 4

#define SELEC 6
#define BACK 7

Adafruit_SH1106 display(OLED_RESET );
int A=3;//CLK
int B=2;//DT
int selec;
int back;
int color = 3;
int i=0;
int sensor =4;
DHT dht(sensor,DHT11);
// 'Phoenix', 128x64px
const unsigned char Logo [] PROGMEM = {
  0xff, 0xff, 0xff, 0xff, 0xff, 0xff, 0xff, 0xff, 0xff, 0xff, 0xff, 0xff, 0xff, 0xff, 0xff, 0xff, 
  0xff, 0xff, 0xff, 0xff, 0xff, 0xff, 0xff, 0xff, 0xff, 0xff, 0xff, 0xc1, 0xff, 0xff, 0xff, 0xff, 
  0xff, 0xff, 0xff, 0xff, 0xff, 0xff, 0xff, 0xff, 0xff, 0xff, 0xf0, 0x01, 0xff, 0xff, 0xff, 0xff, 
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  0xff, 0xff, 0xff, 0xff, 0x01, 0xff, 0xff, 0xff, 0xff, 0xff, 0xff, 0xff, 0xff, 0xff, 0xff, 0xff
};
int temperatura;
int humedad;

void setup() {
 Serial.begin(9600);
 dht.begin();
 display.begin(SH1106_SWITCHCAPVCC, 0x3C);
 pinMode(A, INPUT);
 pinMode(B , INPUT);
 pinMode(SELEC, INPUT_PULLUP);
 pinMode(BACK, INPUT_PULLUP);
 display.clearDisplay();
 display.drawBitmap(0,0,Logo,128,64,1);
 display.display();
 delay(3000);
 attachInterrupt(digitalPinToInterrupt(A),encoder,LOW);
 Serial.println("listo");
  }
  

void loop() {

  selec=digitalRead(SELEC);
  back=digitalRead(BACK);

 if(back == LOW){
  Serial.println("activo");
 }
 if(selec== LOW){
  Serial.println("activo SELEC");
 }

if (color == 3){
  display.clearDisplay();
  display.setTextSize(2);
  display.setTextColor(BLACK,WHITE);
  display.setCursor(0,0);
  display.println("Opcion A");
  display.setTextColor(WHITE);
  display.println("Opcion B");
  display.setTextColor(WHITE);
  display.println("Opcion C");
  display.display();

selec=digitalRead(SELEC);
if(selec==LOW){
   i=1;
   display.clearDisplay();
}
  while(i == 1){
  
  display.setTextSize(1);
  display.setTextColor(WHITE);
  display.setCursor(0,0);
  display.println("¡Seleccionaste A!");
  display.setTextColor(WHITE);
  display.setCursor(0,40);
  display.println("Presiona BACK para regresar");
  display.display();
  display.clearDisplay();

  back=digitalRead(BACK);
  if(back==LOW){i=0;}}
  
 
  }



if (color == 2){
  display.clearDisplay();
  display.setTextSize(2);
  display.setTextColor(WHITE);
  display.setCursor(0,0);
  display.println("Opcion A");
  display.setTextColor(BLACK,WHITE);
  display.println("Opcion B");
  display.setTextColor(WHITE);
  display.println("Opcion C");
  display.display();

  selec=digitalRead(SELEC);
if(selec==LOW){
   i=1;
   display.clearDisplay();
}
  while(i == 1){
    display.clearDisplay();// se necesita para refrescar el buffer
    display.setTextSize(1);
    display.setTextColor(WHITE);
    temperatura= dht.readTemperature();
    humedad = dht.readHumidity();
    display.setTextColor(WHITE); //Establece el color 
  
    display.setCursor(5,5); //Establecer las coordenadas para mostrar la posición del texto
    display.print("Temperatura: ");
    display.print(temperatura);
    display.println(" 'C");

    display.setCursor(20,20); 
    display.print(" Humedad: ");
    display.print(humedad);
    display.println("%");
    display.display();
    delay(100);

    back=digitalRead(BACK);
    if(back==LOW){i=0;}}
  
 
  }


if (color == 1){
  display.clearDisplay();
  display.setTextSize(2);
  display.setTextColor(WHITE);
  display.setCursor(0,0);
  display.println("Opcion A");
  display.setTextColor(WHITE);
  display.println("Opcion B");
  display.setTextColor(BLACK,WHITE);
  display.println("Opcion C");
  display.display();
}

 
 }

void encoder() {
  static unsigned long ultimaInterrupcion =0;
  unsigned long tiempoInterrupcion = millis();
  if (tiempoInterrupcion - ultimaInterrupcion > 5){
  if(digitalRead(B) == HIGH){
  color++;
  }else{
  color--;
  }
   color = min(3, max(1, color));

   ultimaInterrupcion = tiempoInterrupcion;
 }
}
